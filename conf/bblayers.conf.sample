## conf/bblayers.conf.sample
```bitbake
# POKY_BBLAYERS_CONF_VERSION is increased each time build/conf/bblayers.conf
# changes incompatibly
POKY_BBLAYERS_CONF_VERSION = "2"

BBPATH = "${TOPDIR}"
BBFILES ?= ""

BBLAYERS ?= " \
  ~/yocto-builds/poky-morty/meta \
  ~/yocto-builds/poky-morty/meta-poky \
  ~/yocto-builds/poky-morty/meta-openembedded/meta-oe \
  ~/yocto-builds/poky-morty/meta-openembedded/meta-systemd \
  ~/yocto-builds/poky-morty/meta-openembedded/meta-initramfs \
  ~/yocto-builds/poky-morty/meta-raspberrypi \
  ~/yocto-builds/poky-morty/meta-basilisk-ii \
  "
```

## conf/layer.conf
```bitbake
# We have a conf and classes directory, append to BBPATH
BBPATH .= ":${LAYERDIR}"

# We have a recipes directory, add to BBFILES
BBFILES += "${LAYERDIR}/recipes*/*/*.bb ${LAYERDIR}/recipes*/*/*.bbappend ${LAYERDIR}/images/*.bb"

BBFILE_COLLECTIONS += "meta-basilisk-ii"
BBFILE_PATTERN_meta-basilisk-ii := "^${LAYERDIR}/"
BBFILE_PRIORITY_meta-basilisk-ii = "8"
```

## conf/local.conf.sample
```bitbake
# Local Configuration for building basilisk-ii images
# Using Yocto Project 2.2 Poky distribution [morty] branch
CONF_VERSION = "1"

# Host Machine
# ------------

# i686 or x86_64
SDKMACHINE = "x86_64"

# Target Machine
# --------------
MACHINE = "raspberrypi"

# raspberrypi linux kernel settings...
PREFERRED_VERSION_linux-raspberrypi = "4.9.%"

INITRAMFS_IMAGE_BUNDLE = "1"
INITRAMFS_IMAGE = "systemd-plymouth-image-initramfs"

# raspberrypi config.txt settings.
GPU_MEM = "16"
DISABLE_OVERSCAN = "1"

# Distro Setup
# ------------
DISTRO = "poky"

DISTRO_FEATURES = "ext2 pam usbhost alsa directfb systemd ${DISTRO_FEATURES_LIBC}"
DISTRO_FEATURES_BACKFILL_CONSIDERED += "sysvinit"

VIRTUAL-RUNTIME_init_manager = "systemd"
VIRTUAL-RUNTIME_initscripts = "systemd-compat-units"

IMAGE_FSTYPES = "tar.gz"

PACKAGE_CLASSES = "package_ipk"

LICENSE_FLAGS_WHITELIST = "commercial"

EXTRA_IMAGE_FEATURES = "debug-tweaks "

USER_CLASSES = "image-mklibs image-prelink"

PATCHRESOLVE = "noop"

# Build Behavior
# --------------
# Download Directory (can be shared amongst different local.conf setups)
DL_DIR = "~/yocto-builds/oe-sources"

# Shared State cache (Not sure I'd share this one.)
SSTATE_DIR = "~/yocto-builds/build/sstate-cache"

# Working Directory (can be shared amongst different local.conf setups)
TMPDIR = "~/yocto-builds/build/tmp"

RM_OLD_IMAGE = "1"
```
